## boards/microball/microball/Kconfig.microball
```kconfig
config SHIELD_MICROBALL_R
    select $(shields_list_contains,microball_R)

config SHIELD_MICROBALL_L
    select $(shields_list_contains,microball_L)
```

## boards/microball/microball/board.yml
```yaml
board:
  name: microball
  vendor: microball
  revision:
    format: major.minor.patch
    default: 1.0.0
  socs:
  - name: xiao_ble
```

## config/west.yml
```yaml
manifest:
  remotes:
    - name: zmkfirmware
      url-base: https://github.com/zmkfirmware
    - name: badjeff
      url-base: https://github.com/badjeff
    - name: caksoylar
      url-base: https://github.com/caksoylar
    - name: urob
      url-base: https://github.com/urob
  projects:
    - name: zmk
      remote: zmkfirmware
      revision: v0.3.0
      import: app/west.yml
    - name: zmk-pmw3610-driver
      remote: badjeff
      revision: main
    - name: zmk-rgbled-widget
      remote: caksoylar
      revision: main
    - name: zmk-unicode
      remote: urob
      revision: v0.3
  self:
    path: config
```
